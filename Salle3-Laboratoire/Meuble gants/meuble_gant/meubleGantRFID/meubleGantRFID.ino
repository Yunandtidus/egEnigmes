/*
Meuble gant, envoi un signal au back lorsque le cylindre est en position
detection de la position par puce RFID

Lors de la detection on va chercher l'etat du cylindre (etat 0 ou 1)
0 => cylindre non chargé
1 => cylindre chargé, on peut activer la machine à fumé et donner la clé de sortie

cablage RFID:
SDA --> 9
SCK --> 13
MOSI --> 11
MISO --> 12
GND --> GND
RST --> 8
3.3V --> 3.3V

 */


#include <SPI.h>
#include <Ethernet.h>
#include <RFID.h>

// relai pour lacher la clé
int relayCle = A0;
int relayFumee = A1;

// variables pour lecture RFID
RFID RFID(9,8);
String rfidState ="N";
bool statut = 1;

// variables ethernet
String inputString = "";
boolean stringComplete = false;
boolean test = false;

// variable en retour ethernet
String codeRetour = "";

// assign a MAC address for the ethernet controller.
// fill in your address here:
byte mac[] = {
  0xAB, 0xBB, 0xAA, 0xEF, 0xFE, 0xED
};
// fill in an available IP address on your network here,
// for manual configuration:
IPAddress ip(192, 168,1,77);

// fill in your Domain Name Server address here:
IPAddress myDns(1, 1, 1, 1);
IPAddress gateway(192,168,1,1);
IPAddress subnet(255,255,255,0);


// initialize the library instance:
EthernetClient client;

//char server[] = "www.arduino.cc";
IPAddress server(192,168,1,70);

unsigned long lastConnectionTime = 0;             // last time you connected to the server, in milliseconds
const unsigned long postingInterval = 1L * 1000L; // delay between updates, in milliseconds
// the "L" is needed to use long type numbers

void setup() {

  pinMode (relayCle, OUTPUT);
  digitalWrite (relayCle, HIGH);  
  pinMode (relayFumee, OUTPUT);
  digitalWrite (relayFumee, HIGH); 
  

  // disable RFID SPI
  pinMode(9,OUTPUT);
  digitalWrite(9,HIGH);

  // RFID
  SPI.begin();
  RFID.init();
  
  // start serial port:
  Serial.begin(9600);
  while (!Serial) {
    ; // wait for serial port to connect. Needed for native USB port only
  }

  // give the ethernet module time to boot up:
  delay(1000);
  // start the Ethernet connection using a fixed IP address and DNS server:
  Ethernet.begin(mac, ip, myDns);
  // print the Ethernet board/shield's IP address:
  Serial.print("My IP address: ");
  Serial.println(Ethernet.localIP());
}

void loop() {
 
    testRFID();  
    
        if (rfidState == 'Y') {
          // RFID ok et carte presente
          // on contrôle l'état du cylindre
            httpRequest();
          }
          else{
            rfidState = 'N';            
          }
          
        if(codeRetour == "1"){
          // cylindre chargé, on peut donner la clé
          delay(1000);
          Serial.println("gagné fumee");
          digitalWrite (relayFumee, LOW);
          delay(10000);
          digitalWrite (relayFumee, HIGH);
          Serial.println("gagné cle");
          digitalWrite (relayCle, LOW);
          delay(10000);
          digitalWrite (relayCle, HIGH);
          
        }
        
       
        
  // if there's incoming data from the net connection.
  // send it out the serial port.  This is for debugging
  // purposes only:
  while (client.available()) {    
    char inChar = client.read();        
   inputString += inChar;
   // if the incoming character is a newline, set a flag
   // so the main loop can do something about it:
   if (inChar == '\n') {
     stringComplete = true;     
   }   
  }
 
     if (stringComplete) {       
       codeRetour = getParameter(inputString);
       Serial.println(codeRetour); 
       
     } 
  
}

boolean testRFID(){

  if (RFID.isCard()) {  
        // la carte est présente, on set la variable rfidState = 'Y';
          rfidState = 'Y';
          Serial.println("rfid detecte");
           RFID.halt();
          }
   else {
        // la carte est absente, on set la variable rfidState = 'N';
          rfidState = 'N';
           RFID.halt();
    }        
             
        //  RFID.halt();
       
  }

String getParameter(String response){  //ne recupere que la variable dans la reponse
  
  int lengthOfString = inputString.length();     
    int endHttpHeader = inputString.indexOf("\r\n\r\n");    
    String variable = inputString.substring(endHttpHeader,lengthOfString);
    variable.trim();   
    inputString = "";
    return variable;
  }

// this method makes a HTTP connection to the server:
void httpRequest() {
  // close any connection before send a new request.
  // This will free the socket on the WiFi shield
  client.stop();

  // if there's a successful connection:
  if (client.connect(server, 1880)) {
    Serial.println("connecting..test");
    // send the HTTP GET request:
   // client.println("GET /getAll HTTP/1.1");
    client.println("GET /getText?code=CYLINDRE.VARIABLE.CODE HTTP/1.1");
    client.println("Host: 192.168.1.77");
    client.println("User-Agent: arduino-ethernet");
    client.println("Connection: close");
    client.println();

    // note the time that the connection was made:
    lastConnectionTime = millis();
  } else {
    // if you couldn't make a connection:
    Serial.println("connection marche pas");
  }
}

// this method makes a HTTP connection to the server:
void sethttpRequest() {
  // close any connection before send a new request.
  // This will free the socket on the WiFi shield
  client.stop();

  // if there's a successful connection:
  if (client.connect(server, 1880)) {
    Serial.println("connecting...");
    // send the HTTP GET request:
    client.println("GET /set?code=ADMIN.TO.USER&value=bipbip HTTP/1.1");
    client.println("Host: 192.168.1.75");
    client.println("User-Agent: arduino-ethernet");
    client.println("Connection: close");
    client.println();

    // note the time that the connection was made:
    lastConnectionTime = millis();
  } else {
    // if you couldn't make a connection:
    Serial.println("connection failed");
  }
}





